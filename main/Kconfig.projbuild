## main/Kconfig.projbuild
```kconfig
# put here your custom config value
menu "Example Configuration"
config ESP_WIFI_SSID
    string "WiFi SSID"
    default "myssid"
    help
	SSID (network name) for the example to connect to.

config ESP_WIFI_PASSWORD
    string "WiFi Password"
    default "mypassword"
    help
	WiFi password (WPA or WPA2) for the example to use.
endmenu

menu "LCD Configuration"

    choice LCD_CONTROLLER
        prompt "LCD controller model"
        default LCD_CONTROLLER_GC9A01
        help
            Select LCD controller model

        config LCD_CONTROLLER_GC9A01
            bool "GC9A01"
    endchoice

    config LCD_TOUCH_ENABLED
        bool "Enable LCD touch"
        default n
        help
            Enable this option if you wish to use display touch. You can select from touch controllers.

    choice LCD_TOUCH_CONTROLLER
        prompt "LCD touch controller model"
        depends on LCD_TOUCH_ENABLED
        default LCD_TOUCH_CONTROLLER_STMPE610
        help
            Select LCD touch controller model

        config LCD_TOUCH_CONTROLLER_STMPE610
            bool "STMPE610"
            help
                Touch controller STMPE610 connected via SPI.

        config LCD_TOUCH_CONTROLLER_XPT2046
            bool "XPT2046"
            help
                Touch controller XPT2046 connected via SPI.
    endchoice

    config LCD_MIRROR_Y
        int
        default 1 if LCD_TOUCH_ENABLED && LCD_TOUCH_CONTROLLER_XPT2046
        default 0
        help
            This value is 1 if XPT2046 touch controller is selected, 0 otherwise.

endmenu
```

## sdkconfig.defaults
```kconfig
#########################
# System                #
#########################

# Use ESP32-C3 target
CONFIG_IDF_TARGET="esp32"
CONFIG_IDF_TARGET_ESP32=y

# System clock 80 MHz
CONFIG_ESP32_DEFAULT_CPU_FREQ_240=y

# Use partition table from "partitions_config.csv"
CONFIG_PARTITION_TABLE_CUSTOM=y
CONFIG_PARTITION_TABLE_CUSTOM_FILENAME="partitions_config.csv"
CONFIG_PARTITION_TABLE_FILENAME="partitions_config.csv"
CONFIG_ESPTOOLPY_FLASHSIZE_4MB=y

# Idle Task stack size
CONFIG_FREERTOS_IDLE_TASK_STACKSIZE=2048

#########################
# Bluetooth             #
#########################

# Enable Bluetooth
CONFIG_BT_ENABLED=y

# Bluetooth event (callback to application) task stack size
CONFIG_BT_BTC_TASK_STACK_SIZE=8192

# Bluetooth event (callback to application) task stack size
CONFIG_BT_BTU_TASK_STACK_SIZE=8192

# Enables BLE 4.2 features, but not 5.0 features
# CONFIG_BT_BLE_42_FEATURES_SUPPORTED=n
# CONFIG_BT_BLE_50_FEATURES_SUPPORTED=n






#########################
# Power saving          #
#########################

# Enable support for power management
# If enabled, this option has run-time overhead (increased interrupt latency,
# longer time to enter idle state), and it also reduces accuracy of
# RTOS ticks and timers used for timekeeping.
CONFIG_PM_ENABLE=y

# FreeRTOS will be able to put the system into light sleep mode when no tasks need to run for a number
# of ticks. This number can be set using FREERTOS_IDLE_TIME_BEFORE_SLEEP option.
CONFIG_FREERTOS_USE_TICKLESS_IDLE=y

# FreeRTOS will enter light sleep mode if no tasks need to run for this number of ticks
CONFIG_FREERTOS_IDLE_TIME_BEFORE_SLEEP=3

# If enabled, about 1.8KB of lightsleep related source code would be in IRAM and chip would sleep
# longer for 760us at most each time.
CONFIG_PM_SLP_IRAM_OPT=y

# If enabled, about 260B of RTOS_IDLE related source code would be in IRAM and chip would sleep 
# longer for 40us at most each time.
CONFIG_PM_RTOS_IDLE_OPT=y
```
